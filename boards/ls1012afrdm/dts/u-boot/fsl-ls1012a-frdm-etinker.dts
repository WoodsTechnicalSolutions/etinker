// SPDX-License-Identifier: GPL-2.0+ OR X11
/*
 * Device Tree file for Freescale Layerscape-1012A family SoC.
 *
 * Copyright 2016, Freescale Semiconductor
 */

/dts-v1/;
#include "fsl-ls1012a-frdm.dtsi"

/ {
	aliases {
		spi1 = &dspi0;
	};

	chosen {
		stdout-path = &duart0;
	};
};

&dspi0 {
	status = "okay";
};
